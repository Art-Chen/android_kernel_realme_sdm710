## Kconfig
```kconfig
#
# For a description of the syntax of this configuration file,
# see Documentation/kbuild/kconfig-language.txt.
#
mainmenu "Linux/$ARCH $KERNELVERSION Kernel Configuration"

config SRCARCH
	string
	option env="SRCARCH"

config VENDOR_REALME
	bool "REALME support"
	help
	  This feature enables Realme specific hacks

source "arch/$SRCARCH/Kconfig"
```

## drivers/soc/oppo/oppo_mdmrst/Kconfig
```kconfig
# ifdef CONFIG_VENDOR_REALME
# yixue.ge add for config oppo software common soft
config RECORD_MDMRST
bool "config record mdmrst"
help
    define this config to count the modem restart times.
#endif /* CONFIG_VENDOR_REALME */
```
